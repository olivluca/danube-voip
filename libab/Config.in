## libab/Config.in
```kconfig
config BR2_PACKAGE_LIBAB
	prompt "libab ........................ board library for VoIP"
	tristate
	default y if CONFIG_DEVEL
	depends on BR2_LINUX_2_6_SIGRAND5120
```

## svd/Config.in
```kconfig
config BR2_PACKAGE_SVD
	tristate "svd .............. SIP VoIP client daemon"
	default y if CONFIG_DEVEL
	select BR2_PACKAGE_DRV_TAPI
	depends on BR2_LINUX_2_6_SIGRAND5120
```
